## CMakeLists.txt
```
cmake_minimum_required(VERSION 3.20.0)

if(BOARD STREQUAL "nucleo_h7a3zi_q")
    set(BOARD_FLASH_RUNNER openocd)
endif()

set(DTC_OVERLAY_FILE ${CMAKE_CURRENT_SOURCE_DIR}/../common/boards/${BOARD}.overlay)
if(EXISTS ${CMAKE_CURRENT_SOURCE_DIR}/../common/boards/${BOARD}.conf)
    set(EXTRA_CONF_FILE ${CMAKE_CURRENT_SOURCE_DIR}/../common/boards/${BOARD}.conf)
endif()

find_package(Zephyr REQUIRED HINTS $ENV{ZEPHYR_BASE})

project(mlperf_tiny_ic02)

set(MODEL_DIR ${CMAKE_CURRENT_SOURCE_DIR}/model/${BOARD})
if(NOT EXISTS "${MODEL_DIR}/lib/libmodel.a")
    message(FATAL_ERROR "Missing ${MODEL_DIR}/lib/libmodel.a")
endif()

target_sources(app PRIVATE
    src/submitter_implemented.cpp
    ${CMAKE_SOURCE_DIR}/../common/main.cpp
    ${CMAKE_SOURCE_DIR}/../common/internally_implemented.cpp
    ${CMAKE_SOURCE_DIR}/../common/dwt_timestamp.cpp
    ${CMAKE_SOURCE_DIR}/../common/eembc_shim.cpp
)

target_include_directories(app PRIVATE
    ${CMAKE_SOURCE_DIR}
    ${CMAKE_SOURCE_DIR}/../..
    ${MODEL_DIR}/include
)

target_link_libraries(app PRIVATE ${MODEL_DIR}/lib/libmodel.a)
```

## Kconfig
```
mainmenu "MLPerf Tiny IC01 (Image Classification) Configuration"

source "Kconfig.zephyr"
```

## prj.conf
```kconfig
CONFIG_CPP=y
CONFIG_PICOLIBC=y
CONFIG_CONSOLE=y
CONFIG_UART_CONSOLE=y
CONFIG_SERIAL=y
CONFIG_TIMING_FUNCTIONS=y
CONFIG_CORTEX_M_DWT=y
CONFIG_PM=n
CONFIG_FPU=y
CONFIG_TICKLESS_KERNEL=y
CONFIG_SPEED_OPTIMIZATIONS=y
CONFIG_COMPILER_OPT="-O3"
CONFIG_MAIN_STACK_SIZE=4096
CONFIG_HW_STACK_PROTECTION=y
CONFIG_HEAP_MEM_POOL_SIZE=1024
```

## src/submitter_implemented.cpp
```c
/* IC02 (larger ResNet variant of IC01). Same wire format and output
 * shape; only the model differs. */

#include <stddef.h>
#include <stdint.h>

#include "firmware/common/internally_implemented.h"
#include "api/submitter_implemented.h"
#include "firmware/common/eembc_shim.h"
#include "model.h"

static constexpr float kModelOutputScale = 0.00390625f;  /* 1/256 */
static constexpr int   kModelOutputZeroPoint = -128;

void th_load_tensor() {
    uint8_t staged[MAX_DB_INPUT_SIZE];
    size_t bytes = ee_get_buffer(staged, MAX_DB_INPUT_SIZE);
    if (bytes != MAX_DB_INPUT_SIZE) {
        th_printf("e-[Input has %u bytes, expected %u]\r\n",
                  static_cast<unsigned>(bytes),
                  static_cast<unsigned>(MAX_DB_INPUT_SIZE));
        return;
    }
    int8_t *model_input = reinterpret_cast<int8_t *>(get_model_input_buffer());
    for (size_t i = 0; i < MAX_DB_INPUT_SIZE; ++i) {
        model_input[i] = static_cast<int8_t>(staged[i] - 128);
    }
}

void th_results() {
    emit_classifier_results(
        reinterpret_cast<const int8_t *>(get_model_output_buffer()),
        MODEL_OUTPUT_BYTES,
        kModelOutputScale, kModelOutputZeroPoint);
}
```
